#include "led.h"
#include "stdlib.h"
#include "delay.h"
#define mode  2
const unsigned char PIC3[95][16]=
{
{0x00,0x00,0x00,0x00,0x00,0x00,0x00,0x00,0x00,0x00,0x00,0x00,0x00,0x00,0x00,0x00},/*" ",0*/
{0x00,0x00,0x00,0x08,0x08,0x08,0x08,0x08,0x08,0x08,0x00,0x00,0x18,0x18,0x00,0x00},/*"!",1*/
{0x00,0x48,0x6C,0x24,0x12,0x00,0x00,0x00,0x00,0x00,0x00,0x00,0x00,0x00,0x00,0x00},/*""",2*/
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{0x0C,0x32,0xC2,0x00,0x00,0x00,0x00,0x00,0x00,0x00,0x00,0x00,0x00,0x00,0x00,0x00},/*"~",94*/
};
void LCD_Writ_Bus(char data_1,char data_2)   //并行数据写入函数
{	
	//下面是由于芯片引脚和lcd的数据传输引脚相反，所以需要把传输数据颠倒顺序再传输
	u16 i,j, addr2 = 0,addr3 = 0;
	u32 temp2,temp3;
	for(i=0;i<=7;i++)
	{
		addr2 = addr2 << 1;
		addr2 = addr2 | (data_1 & 1);
		data_1 = data_1 >> 1;
	}
	for(j=0;j<=7;j++)
	{
		addr3 = addr3 << 1;
		addr3 = addr3 | (data_2 & 1);
		data_2 = data_2 >> 1;
	}
	addr2 = addr2<<8; //因为用的芯片引脚是高八位，所以左移8位
	addr3 = addr3<<8;
	
	CS = 0;
	WR = 1;
	temp2 = (GPIOE->IDR&0xff00);
	GPIOE->BSRR = temp2<<16;
	GPIOE->BSRR = addr2;
	WR = 0;  //写操作使能
	WR = 1;  //写操作失能
	CS = 1;
	
	CS = 0;
	WR = 1;
	temp3 = (GPIOE->IDR&0xff00);
	GPIOE->BSRR = temp3<<16;
	GPIOE->BSRR = addr3;
	WR = 0;
	WR = 1;
//	CS = 1;   //关闭片选使能
}

void LCD_WR_DATA8(char VH,char VL) //发送数据-8位参数
{
    LCD_RS=1;
	LCD_Writ_Bus(VH,VL);
}
/***************************写数据**********************************************/
void LCD_WR_DATA(int da)   
{
    LCD_RS=1;
	LCD_Writ_Bus(da>>8,da);
}
/***************************写命令**************************************************/
void LCD_WR_REG(int reg)
{
	LCD_RS = 0;
	LCD_Writ_Bus(reg>>8,reg);
}
/****************************写命令和数据**********************************************/
void LCD_WR_REG_DATA(int reg,int da)
{
	LCD_WR_REG(reg);
	LCD_WR_DATA(da);
}


/****************初始化命令*******************/
 void LCD_Init()
{
	
	GPIO_InitTypeDef GPIO_InitStructure;//重新定义一个结构体
	
	//开启时钟线，stm32有，单片机没有
	RCC_APB2PeriphClockCmd(RCC_APB2Periph_GPIOB|RCC_APB2Periph_GPIOD|RCC_APB2Periph_GPIOE, ENABLE);
	
	//对结构体的变量进行初始化
	GPIO_InitStructure.GPIO_Pin = GPIO_Pin_7|GPIO_Pin_8|GPIO_Pin_9|GPIO_Pin_10|GPIO_Pin_11|GPIO_Pin_12|
	GPIO_Pin_13|GPIO_Pin_14|GPIO_Pin_15;
	GPIO_InitStructure.GPIO_Mode = GPIO_Mode_Out_PP;
	GPIO_InitStructure.GPIO_Speed = GPIO_Speed_50MHz;
	GPIO_Init(GPIOE,&GPIO_InitStructure);//把结构体的成员变量赋给对应寄存器
	
	
	GPIO_InitStructure.GPIO_Pin = GPIO_Pin_8|GPIO_Pin_9|GPIO_Pin_10;
	GPIO_Init(GPIOD,&GPIO_InitStructure);//把结构体的成员变量赋给对应寄存器
	
	
	GPIO_InitStructure.GPIO_Pin = GPIO_Pin_15;
	GPIO_Init(GPIOB,&GPIO_InitStructure);//把结构体的成员变量赋给对应寄存器
	
	RST = 0;
	delay_ms(20);
	RST = 1;
	delay_ms(10);
	
	
	LCD_CS=1;
	LCD_RD=1;
	LCD_WR=1;
	delay_ms(5);
	LCD_CS =0;  //打开片选使能
	
	//下面是初始代码，不需要知道全部细节，一般由厂家提供
	//需要修改时要参考数据手册,初始化程序不一样显示效果也不一样
	LCD_WR_REG_DATA(0x0001, 0x011C); // 0x011c set SS and NL bit    扫描方向,使用多少行
		LCD_WR_REG_DATA(0x0002, 0x0100); // set 1 line inversion   扫描模式
		LCD_WR_REG_DATA(0x0003, 0x0030); // set GRAM write direction an d BGR=1.    扫描方向
		LCD_WR_REG_DATA(0x0008, 0x0808); // set BP and FP?
		LCD_WR_REG_DATA(0x000C, 0x0000); // RGB interface setting R0Ch=0x0110 for RGB 18Bit and R0Ch=0111 for RGB 16Bit
		LCD_WR_REG_DATA(0x000F, 0x0801); // Set frame rate
		LCD_WR_REG_DATA(0x0020, 0x0000); // Set GRAM Address
		LCD_WR_REG_DATA(0x0021, 0x0000); // Set GRAM Address
		//*************Power On sequence ****************//
		delay_ms(5); // Delay 50ms
		LCD_WR_REG_DATA(0x0010, 0x0A00); // Set SAP,DSTB（睡眠模式设置位，控制内部电源）,STB（睡眠模式设置位，控制内部晶振）
		LCD_WR_REG_DATA(0x0011, 0x103B); // Set APON,PON,AON,VCI1EN,VC
		delay_ms(5); // Delay 50ms
		LCD_WR_REG_DATA(0x0012, 0x6121); // Internal reference voltage= Vci;
		LCD_WR_REG_DATA(0x0013, 0x006F); // Set GVDD(VREG1OUT),为什么为4.68V这个电压值
		LCD_WR_REG_DATA(0x0014, 0x3745); // 345d ok Set VCOMH/VCOML voltage  4440 4d50，VCOMH=4.1184,VCOM=2.2464,VCOMH，VCOM这两个值与屏的哪些现象有关系
		//------------------------ Set GRAM area --------------------------------//
		LCD_WR_REG_DATA (0x30, 0x0000);//显示起始行设定
		LCD_WR_REG_DATA (0x31, 0x0000);//垂直滚动显示的结束地址设定
		LCD_WR_REG_DATA (0x32, 0x0000);//垂直滚动显示的开始地址设定
		LCD_WR_REG_DATA (0x33, 0x0000);//?
		
		LCD_WR_REG_DATA (0x34, 0x00DB);//设定显示的结束行，SE1(7:0)
		LCD_WR_REG_DATA (0x35, 0x0000);//设定显示的开始行，SS1(7:0)
		
		LCD_WR_REG_DATA (0x36, 0x00AF);//设定显示结束的列，HEA(7:0)
		LCD_WR_REG_DATA (0x37, 0x0000);//设定显示开始的列，HSA(7:0)
		LCD_WR_REG_DATA (0x38, 0x00DB);//设定显示结束的行，VEA(7:0)
		LCD_WR_REG_DATA (0x39, 0x0000);//设定显示开始的行，VSA(7:0)*/
		// ----------- Adjust the Gamma Curve ----------//
	/*	LCD_WR_REG_DATA(0x0050, 0x0000);
		LCD_WR_REG_DATA(0x0051, 0x0808);
		LCD_WR_REG_DATA(0x0052, 0x080A);
		LCD_WR_REG_DATA(0x0053, 0x000A);
		LCD_WR_REG_DATA(0x0054, 0x0A08);
		LCD_WR_REG_DATA(0x0055, 0x0808);
		LCD_WR_REG_DATA(0x0056, 0x0000);
		LCD_WR_REG_DATA(0x0057, 0x0A00);
		LCD_WR_REG_DATA(0x0058, 0x1007);
		LCD_WR_REG_DATA(0x0059, 0x0710);*///BOE
		LCD_WR_REG_DATA(0x0050, 0x0400);
		LCD_WR_REG_DATA(0x0051, 0x080B);
		LCD_WR_REG_DATA(0x0052, 0x0E0C);//0x50~0x52,The gamma fine adjustoment register for the positive polarity output
		LCD_WR_REG_DATA(0x0053, 0x0103);//The gradient adjustment register for the positive polarity output.(对于阳极梯度调整寄存器）
		LCD_WR_REG_DATA(0x0054, 0x0C0E);
		LCD_WR_REG_DATA(0x0055, 0x0B08);
		LCD_WR_REG_DATA(0x0056, 0x0004);//0x54~0x56,The gamma fine adjustment register for the negative polarity output.
		LCD_WR_REG_DATA(0x0057, 0x0301);//The gradient adjustment register for the negative polarity output
		LCD_WR_REG_DATA(0x0058, 0x0E00);//The amplitude adjustment register for the negative polarity output
		LCD_WR_REG_DATA(0x0059, 0x000E);//The amplitude adjustment register for the negative polarity output, //CMO玻璃
		delay_ms(5); // Delay 50ms
		LCD_WR_REG_DATA(0x0007, 0x1017);
	delay_ms(20);
		

}

/*************************三色函数**********************************************/
void LCD_Clear()
{
	u8 i,j;
	LCD_WR_REG_DATA(0x36,0x00af);     //horizontal address  水平地址高八位
	LCD_WR_REG_DATA(0x37,0x0000);	  //horizontal address  水平地址低八位
	LCD_WR_REG_DATA(0x38,0x00db);	  //vertical address    垂直地址高八位
	LCD_WR_REG_DATA(0x39,0x0000);     //vertical address    垂直地址高八位
	
	LCD_WR_REG_DATA(0x20,0x0000);    //GRAM address set   设置地址计数器的初始值    
	LCD_WR_REG_DATA(0x21,0x0000);
	
	LCD_WR_REG(0x22);
	
	RS = 1;  //写数据
	CS = 0;
	for (i = 0; i < 220; i++) 
	{
		if(i<73)
		 {
			for(j=0;j<176;j++)
			 {
				LCD_WR_DATA(0); 
			 }
		 }
		 else if(i<146)
		 {
			 for(j=0;j<176;j++)
			 {
				 LCD_WR_DATA(0);
			 }
		 }
		 else
		 {
			 for(j=0;j<176;j++)
			 {
				 LCD_WR_DATA(0x0000);
			 }
		 }
			
	}
	
}

/************显示字符************/
void showchar(u8 a,u8 b,u8 num)
{
	u8 i=0,j=0,temp=0;
	LCD_qu(a,b,a+7,b+15);
	LCD_WR_REG_DATA(0x20,a);    //GRAM address set   设置地址计数器的初始值    
	LCD_WR_REG_DATA(0x21,b);
	LCD_WR_REG(0x22);
	for(j=0;j<16;j++)
	{
		temp = PIC3[num][j];  //提取对应字符字模数据
		for(i=0;i<8;i++)     //八位二进制数据
		{
			if(temp&0x01) LCD_WR_DATA(red);
			else LCD_WR_DATA(0x0000);
			temp >>= 1;
		}
	}
}

/************开区******************/

void LCD_qu(u16 x,u16 y,u16 xend,u16 yend)
{

	
	LCD_WR_REG(0x0036);
	LCD_WR_DATA(xend);
	LCD_WR_REG(0x0037);
	LCD_WR_DATA(x);
	LCD_WR_REG(0x0038);
	LCD_WR_DATA(yend);
	LCD_WR_REG(0x0039);
	LCD_WR_DATA(y);
	//需要自己在后面程序自己添加如下语句：
	//LCD_WR_REG_DATA(0x20,x);   //自己开区的x起始坐标    
	//LCD_WR_REG_DATA(0x21,y);	 //自己开区的y起始坐标
	//LCD_WR_REG(0x22);
}
//测试用函数
void LCD_S(u16 x,u16 y,u16 xend,u16 yend,u16 color)
{
	u8 i=0,j=0,temp=0;
	LCD_qu(15,0,20,15);
	LCD_WR_REG(0x22);
	for(j=0;j<33;j++)
	{
		LCD_WR_DATA(red);
	}
}